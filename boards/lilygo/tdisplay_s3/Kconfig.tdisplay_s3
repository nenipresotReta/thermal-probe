## boards/lilygo/tdisplay_s3/Kconfig.tdisplay_s3
```kconfig
config BOARD_TDISPLAY_S3
    select SOC_ESP32S3_WROOM_N8
    select SOC_ESP32S3_PROCPU
```

## boards/lilygo/tdisplay_s3/board.yml
```yaml
board:
  name: tdisplay_s3
  full_name: T-Display S3 Compatible Thermal Probe
  vendor: lilygo
  socs:
    - name: esp32s3
```
